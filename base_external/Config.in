## base_external/Config.in
```kconfig
# base_external_br2_tree/Config.in
menu "External packages (project_base)"

source "$BR2_EXTERNAL_PROJECT_BASE_PATH/package/aesd-assignments/Config.in"

endmenu
```

## base_external/configs/aesd_qemu_defconfig
```kconfig
BR2_aarch64=y
BR2_KERNEL_HEADERS_6_6=y
BR2_TARGET_GENERIC_ROOT_PASSWD="root"
BR2_LINUX_KERNEL=y
BR2_LINUX_KERNEL_USE_ARCH_DEFAULT_CONFIG=y
BR2_PACKAGE_RNG_TOOLS=y
BR2_PACKAGE_DROPBEAR=y
BR2_TARGET_ROOTFS_EXT2=y
BR2_TARGET_ROOTFS_EXT2_4=y
BR2_TARGET_ROOTFS_EXT2_SIZE="256M"
# BR2_TARGET_ROOTFS_TAR is not set
BR2_PACKAGE_AESD_ASSIGNMENTS=y
```
